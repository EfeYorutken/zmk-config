## boards/shields/keychron_b1pro/Kconfig.defconfig
```kconfig
if SHIELD_KEYCHRON_B1PRO

config ZMK_KEYBOARD_NAME
    default "keychron_b1pro"

endif # SHIELD_KEYCHRON_B1PRO
```

## boards/shields/keychron_b1pro/Kconfig.shield
```kconfig
config SHIELD_KEYCHRON_B1PRO
    def_bool $(shields_list_contains,keychron_b1pro)
```
